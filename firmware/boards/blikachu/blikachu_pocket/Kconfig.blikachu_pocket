## firmware/boards/blikachu/blikachu_pocket/Kconfig.blikachu_pocket
```kconfig
# SPDX-License-Identifier: Apache-2.0

config BOARD_BLIKACHU_POCKET
	select SOC_BL618M05Q2I if BOARD_BLIKACHU_POCKET_BL618M05Q2I
```

## firmware/boards/blikachu/blikachu_pocket/board.yml
```yaml
board:
  name: blikachu_pocket
  full_name: BLikachu Pocket
  vendor: blikachu
  socs:
    - name: bl618m05q2i
```
